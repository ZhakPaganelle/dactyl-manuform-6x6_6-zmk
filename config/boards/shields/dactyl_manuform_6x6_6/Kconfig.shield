## config/boards/shields/dactyl_manuform_6x6_6/Kconfig.shield
```kconfig
config SHIELD_DACTYL_MANUFORM_6x6_6_LEFT
    def_bool $(shields_list_contains,dactyl_manuform_6x6_6_left)

config SHIELD_DACTYL_MANUFORM_6x6_6_RIGHT
    def_bool $(shields_list_contains,dactyl_manuform_6x6_6_right)
```
