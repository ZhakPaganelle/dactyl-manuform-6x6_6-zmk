#include "dactyl_manuform_6x6_6.dtsi"

&default_transform { // The matrix transform for this board is 6 columns over because the left half is 6 columns wide according to the matrix.
    col-offset = <6>;
};

&kscan0 {
    col-gpios
        = <&pro_micro 9 GPIO_ACTIVE_HIGH>
        , <&pro_micro 8 GPIO_ACTIVE_HIGH>
        , <&pro_micro 7 GPIO_ACTIVE_HIGH>
        , <&pro_micro 6 GPIO_ACTIVE_HIGH>
        , <&pro_micro 5 GPIO_ACTIVE_HIGH>
        , <&pro_micro 4 GPIO_ACTIVE_HIGH>
        ;
};


/dts-v1/;
/plugin/;

&default_transform {
    // Для ПРАВОЙ половины берем следующие 36 позиций из map.
    // Нумерация продолжается с 36.
    keys = <
        // Первые 4 строки по 6 клавиш = 24 клавиши
        36 37 38 39 40 41
        42 43 44 45 46 47
        48 49 50 51 52 53
        54 55 56 57 58 59
        // Нижние клавиши (оставшиеся 12 позиций для правой половины)
        60 61 62 63 64 65 66 67 68 69 70 71
    >;
};
