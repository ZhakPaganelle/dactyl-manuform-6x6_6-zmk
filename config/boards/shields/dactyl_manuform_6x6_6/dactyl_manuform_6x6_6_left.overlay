#include "dactyl_manuform_6x6_6.dtsi" // Notice that the main dtsi files are included in the overlay.

&kscan0 {
    col-gpios
        = <&pro_micro 4 GPIO_ACTIVE_HIGH>
        , <&pro_micro 5 GPIO_ACTIVE_HIGH>
        , <&pro_micro 6 GPIO_ACTIVE_HIGH>
        , <&pro_micro 7 GPIO_ACTIVE_HIGH>
        , <&pro_micro 8 GPIO_ACTIVE_HIGH>
        , <&pro_micro 9 GPIO_ACTIVE_HIGH>
        ;
};

/dts-v1/;
/plugin/;

// Обращаемся к узлу трансформации по его метке из основного .dtsi
&default_transform {
    // ВАЖНО: Свойство `keys` должно содержать последовательные числа,
    // соответствующие порядку клавиш в свойстве `map`.
    // Для ЛЕВОЙ половины берем только первые 36 позиций из map (согласно вашей схеме).
    keys = <
        // Первые 4 строки по 6 клавиш = 24 клавиши
        0  1  2  3  4  5
        6  7  8  9  10 11
        12 13 14 15 16 17
        18 19 20 21 22 23
        // Нижние клавиши (оставшиеся 12 позиций для левой половины)
        24 25 26 27 28 29 30 31 32 33 34 35
    >;
};
